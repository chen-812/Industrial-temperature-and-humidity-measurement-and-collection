#include "PCAP01AD.h"
#include "SPI_PCAP.h"
#include "math.h"
#include "stdio.h"
#include "stdint.h"
#include "delay.h"

static unsigned char Send_data[5] = {0};
static unsigned char Read_data[5] = {0};
const unsigned char Firmware_data[960] =
{       0x00,0x00,0x00,0x62,0x63,0x00,0x65,0xBE,0x01,0x20,0x26,0x42,0x5C,0x48,0xA0,0x03,
		0x20,0x65,0x20,0x31,0xA1,0x03,0x20,0x65,0x20,0x31,0x84,0x01,0x21,0xE8,0x01,0x00,
		0x00,0x00,0x00,0x00,0x20,0x0B,0x43,0x58,0xC0,0xFE,0x43,0xC0,0x44,0x7A,0x7E,0x20,
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		0xFF,0xFF,0xFF,0xFF,0xFF,0xFF,0xFF,0xFF,0xFF,0xFF,0xFF,0xFF,0xFF,0xFF,0xFF,0xFF
};

/*

    初始化指令

*/

void PCAP01_Command(unsigned char value)
{
	Send_data[0]=value;  //
	SSPI_SendData(SDCOMD);
}

/*

fun name :SSPI_SendData

input:
          size  发送数据大小：操作码

return : 返回状态
*/

void SSPI_SendData(unsigned char size)
{
	CAP_SPI_Transmit(Send_data,size);
}


void PCAP01_Wirte_SRAM(unsigned short address,unsigned char value)
{
	Send_data[0]=WSRAM<<4^(unsigned char)(address>>8);
	Send_data[1]=(unsigned char)(address&0x00ff);
	Send_data[2]=value;
	SSPI_SendData(SDFIRMWR);
}


unsigned char PCAP01_Read_SRAM(unsigned short address)
{

	Send_data[0]=RSRAM<<4^(unsigned char)(address>>8);
	Send_data[1]=(unsigned char)(address & 0x00ff);
	Send_data[2]=0xff;
	delay_ms(10);

	CAP_SPI_TransmitReceive(Send_data,Read_data,3);

	delay_ms(10);

	return (Read_data[2]);
}

void Send_RegisterData(unsigned char address,unsigned long value)
{
	Send_data[0]=0xC0^address;
	Send_data[1]=(unsigned char)(value>>16);
	Send_data[2]=(unsigned char)((value>>8)&0x000000ff);
	Send_data[3]=(unsigned char)(value&0x000000ff);
	SSPI_SendData(SDREGISTWR);
}



void PCAP01_Write_Register()
{
//	Send_RegisterData(0,0x4200FF);//slave mode
//	Send_RegisterData(1,0x201022);// 50hz
//	Send_RegisterData(2,0x0F050B);//0x0F460B//0x0F450B//0x0F050B
//	Send_RegisterData(3,0x0D0064);
//	Send_RegisterData(4,0x080501);   // h xx xx 01  @abner 2019.10.30 setting based on datasheet
//	Send_RegisterData(5,0xc00064);  // h cx xx xx
//	Send_RegisterData(6,0x000c40); // h 00 43 40
//	Send_RegisterData(7,0x1F0000);
//	Send_RegisterData(8,0x800030);
//	Send_RegisterData(9,0xFF000F);
//	Send_RegisterData(10,0x180087);
//	Send_RegisterData(20,0x000001);

    //Single floating capacitors 1 sensor, 1 reference, fully compensated R_disch = 90 kOhm cycle time = 20 μs 12.2 Hz data rate Averaging 100 samples
    Send_RegisterData(0,0x4200FF);//slave mode
    Send_RegisterData(1,0x201022);// 50Khz
    Send_RegisterData(2,0x1F150B);//PC0-PC4,接地单电容，90kohm
    Send_RegisterData(3,0x0B0064);
    Send_RegisterData(4,0x040900);//不测温度。第一次测试从 0x041300 开始确保时间足够，在减小时间
    Send_RegisterData(5,0x000000);
    Send_RegisterData(6,0x000040);//不测温度
    Send_RegisterData(7,0x1F0000);
    Send_RegisterData(8,0x800030);
    Send_RegisterData(9,0xFF000F);
    Send_RegisterData(10,0x180087);
		Send_RegisterData(18,0x000000);
    Send_RegisterData(20,0x000001);
}


void PCAP01_Init()
{
	uint32_t SRAMRead_value=0;

    uint32_t timeout=0;
    uint32_t i;


    do{  // 循环检测,确保系统启动
        PCAP01_Command(0x88);
        delay_ms(20);
        PCAP01_Wirte_SRAM(0x01f,0x1f);
        SRAMRead_value=PCAP01_Read_SRAM(0x01f);   // 读取系统的值
        delay_ms(50);
        timeout++;
     }while( (SRAMRead_value!=0x1f) && (timeout<0xff));


	if( (timeout>=0xff))
    {
        return;
    }
	else
	{
		PCAP01_Command(0x88);
		delay_ms(20);
		for(i=0;i<960;i++)  // previous : 928,  now is 960
		{
			PCAP01_Wirte_SRAM(i,Firmware_data[i]);  // 更新dsp的算法部分
		}
		PCAP01_Write_Register();
		delay_ms(20);
		PCAP01_Command(0x8a);
		delay_ms(20);
		PCAP01_Command(0x8c);
		delay_ms(20);

	}

}



uint32_t Read_Register(unsigned char address)
{
    uint32_t result_data=0;
    SSN_LOW;   // 拉低CS片选，让PCAP01AD进入SPI通信状态
      delay_us(10);

    Send_data[0]=0x40^address;
    Send_data[1]=0xff;
    Send_data[2]=0xff;
    Send_data[3]=0xff;
    Send_data[4]=0xff;

    CAP_SPI_TransmitReceive(Send_data,Read_data,4);

    result_data |=Read_data[1];
    result_data=result_data<<8;
    result_data |=Read_data[2];
    result_data=result_data<<8;
    result_data |=Read_data[3];

    SSN_HIGH;  // 拉高CS，结束本次通信
    delay_us(10);
    printf("Read Reg 0x%02X: 0x%08lX\r\n", address, result_data);
    return result_data;

}


//电容线性拟合
float C_a=1.0825;
float C_b=-5.516;

unsigned char no_signal_flag_h=0;

float PCAP01_result(CHANNEL channel)
{
    float result_c;
	unsigned long status_register=0;
	unsigned long result_register=0;

	status_register=Read_Register(0x08);    //读状态寄存器

	printf("STATUS: %08lX\r\n", status_register); // 新加这句
	if((status_register!=0x100000)&&(status_register!=0x900000))
	{
	    no_signal_flag_h=1;
	    return 0;
	}
	else
	{
        result_register=Read_Register(channel);
        result_c=(float)result_register/2097152*CAP0_VALUE;

        if(IF_POLY_FIT)
        {
            if((result_c*C_a+C_b)<0)
            {
                no_signal_flag_h=1;
                return 0;
            }
            else
            {
                no_signal_flag_h=0;
                return result_c*C_a+C_b;
            }
        }
        else
        {
            no_signal_flag_h=0;
            return result_c;
        }
	}
}


float read_humidity(void)
{
    float humidity;

    humidity=PCAP01_result(res1);

    return humidity;
}


